## src/mainboard/foxconn/g31mx/Kconfig
```kconfig
## SPDX-License-Identifier: GPL-2.0-only

if BOARD_FOXCONN_G31MX

config BOARD_SPECIFIC_OPTIONS
	def_bool y
	select CPU_INTEL_SOCKET_LGA775
	select NORTHBRIDGE_INTEL_G31
	select SOUTHBRIDGE_INTEL_I82801GX
	select SUPERIO_ITE_IT8718F
	select HAVE_ACPI_TABLES
	select BOARD_ROMSIZE_KB_8192
	select DRIVERS_UART_8250IO
	select FIXED_UART_FOR_CONSOLE
	select POST_IO
	select IOAPIC_USE_PRESET_ID
	select HAVE_OPTION_TABLE
	select HAVE_CMOS_DEFAULT
	select HAVE_ACPI_RESUME
	select DRIVERS_OPTION_CFR_ENABLED
	select DRIVERS_EFI_VARIABLE_STORE if SMMSTORE

config G31MX_POST_BEEPS
	string "POST beep sequence"
	default "896:80"
	help
	  Notes played at the end of POST, separated by spaces, each as
	  <frequency in Hz>:<duration in ms>. A frequency of 0 is a pause.
	  Leave empty for no beep. The default is the vendor BIOS's single
	  POST beep. Example: "1047:100 0:50 1319:100 0:50 1568:200".

config MAINBOARD_DIR
	default "foxconn/g31mx"

config G31MX_USE_IGFX
	bool "Use onboard G31 VGA without a PEG graphics card"
	default y
	select ONBOARD_VGA_IS_PRIMARY
	help
	  Like the vendor BIOS, use a display controller in the PEG slot when
	  one is fitted and the onboard analog VGA controller otherwise. The
	  G31 cannot run both. Requires the board's Intel 8086:29c2 VGA
	  option ROM.

config OVERRIDE_DEVICETREE
	default "variants/igfx/overridetree.cb" if G31MX_USE_IGFX

config VGA_BIOS_ID
	default "8086,29c2" if G31MX_USE_IGFX

config VGA_BIOS_FILE
	default "3rdparty/mainboard/foxconn/g31mx/vgabios.bin" if G31MX_USE_IGFX

config SMM_RESERVED_SIZE
	default 0 if G31MX_USE_IGFX && NO_STAGE_CACHE

config MAINBOARD_PART_NUMBER
	default "G31MX-K"

# No per-board serial or fitted PCB revision has been verified.
config MAINBOARD_SERIAL_NUMBER
	default ""

config MAINBOARD_VERSION
	default ""

config POST_IO_PORT
	default 0x80

config SEABIOS_BOOTORDER_FILE
	default "$(top)/src/mainboard/$(MAINBOARDDIR)/bootorder"

# SeaBIOS misses full-speed devices EHCI hands to UHCI with its 100 ms default.
config SEABIOS_USB_TIME_SIGATT
	default 500

endif # BOARD_FOXCONN_G31MX
```

## src/mainboard/foxconn/g31mx/Kconfig.name
```kconfig
## SPDX-License-Identifier: GPL-2.0-only

config BOARD_FOXCONN_G31MX
	bool "G31MX-K"
```
